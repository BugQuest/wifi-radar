## firmware/main/Kconfig.projbuild
```kconfig
menu "Wifi Radar Configuration"

    config RADAR_SENSOR_ID
        string "Sensor identifier"
        default "r0"
        help
            Short ID emitted in every JSON event under "sid". Use a unique
            value per ESP32 when running multiple sensors (e.g. r0, r1, r2).

    config RADAR_WIFI_SSID
        string "Target AP SSID"
        default "changeme-ssid"
        help
            Build-time fallback SSID. The runtime SSID is stored in NVS and
            pushed from the web UI's WiFi config panel. This default only
            applies on first boot before any NVS entry is written.

    config RADAR_WIFI_PASSWORD
        string "Target AP Password"
        default "changeme-password"
        help
            Build-time fallback password. The real password is stored in NVS
            (encrypted on the ESP32 partition) and pushed at runtime.
            Empty for open networks.

    config RADAR_UART_BAUD
        int "UART baud rate for data output"
        default 921600
        help
            High baud rate is necessary to stream CSI without backpressure.

    config RADAR_PING_ENABLED
        bool "Enable periodic gateway ping (boosts CSI rate)"
        default y
        help
            When enabled, the sensor pings the AP gateway on a fixed interval
            so the Wi-Fi radio receives traffic and produces CSI reports at a
            stable rate.  Every ping frame on the channel is also visible to
            the other sensors in promiscuous mode, so a single ping session
            per sensor boosts CSI throughput for the whole fleet.

    config RADAR_PING_INTERVAL_MS
        int "Gateway ping interval (ms)"
        default 50
        range 10 5000
        help
            Period between ICMP echo requests sent to the gateway.  Lower
            value = more CSI samples per second but more channel airtime.
            50 ms (20 Hz) is a good default.

endmenu
```

## firmware/sdkconfig.defaults
```kconfig
# ===== Wifi Radar — sane defaults =====

# Target chip
CONFIG_IDF_TARGET="esp32"

# UART console — 921600 baud needed to keep up with sniff+CSI throughput
# without ringbuffer overflows.
CONFIG_ESP_CONSOLE_UART_DEFAULT=y
CONFIG_ESP_CONSOLE_UART_BAUDRATE=921600
CONFIG_ESP_CONSOLE_UART_BAUDRATE_921600=y

# Log level (info by default; we'll use our own JSON output channel)
CONFIG_LOG_DEFAULT_LEVEL_INFO=y

# ===== Wi-Fi CSI =====
CONFIG_ESP_WIFI_CSI_ENABLED=y

# ===== Wi-Fi stack tuning for sniffing + CSI =====
CONFIG_ESP_WIFI_STATIC_RX_BUFFER_NUM=16
CONFIG_ESP_WIFI_DYNAMIC_RX_BUFFER_NUM=32
CONFIG_ESP_WIFI_DYNAMIC_TX_BUFFER_NUM=32
CONFIG_ESP_WIFI_AMPDU_RX_ENABLED=n
CONFIG_ESP_WIFI_AMPDU_TX_ENABLED=n

# ===== FreeRTOS =====
CONFIG_FREERTOS_HZ=1000

# ===== Misc =====
CONFIG_COMPILER_OPTIMIZATION_PERF=y
CONFIG_BOOTLOADER_LOG_LEVEL_WARN=y
```
